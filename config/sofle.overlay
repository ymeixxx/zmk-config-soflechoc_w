/ {
    encoders {
        compatible = "zmk,encoders";
        encoder_left {
            compatible = "alps,ec11";
            a-gpios = <&gpio0 10 (GPIO_ACTIVE_HIGH | GPIO_PULL_UP)>;
            b-gpios = <&gpio0 9 (GPIO_ACTIVE_HIGH | GPIO_PULL_UP)>;
            steps = <15>;
        };
        encoder_right {
            compatible = "alps,ec11";
            a-gpios = <&gpio0 5 (GPIO_ACTIVE_HIGH | GPIO_PULL_UP)>;
            b-gpios = <&gpio0 4 (GPIO_ACTIVE_HIGH | GPIO_PULL_UP)>;
            steps = <15>;
        };
    };
};
